## config/boards/shields/Kconfig.defconfig
```kconfig
if SHIELD_ERGOKEY_V0_LEFT

config ZMK_KEYBOARD_NAME
    default "ergokey_v0"

config ZMK_SPLIT_ROLE_CENTRAL
    default y

endif

if SHIELD_ERGOKEY_V0_LEFT || SHIELD_ERGOKEY_V0_RIGHT

config ZMK_SPLIT
    default y

endif
```

## config/boards/shields/Kconfig.shield
```kconfig
config SHIELD_ERGOKEY_V0_LEFT
    def_bool $(shields_list_contains,ergokey_v0_left)

config SHIELD_ERGOKEY_V0_RIGHT
    def_bool $(shields_list_contains,ergokey_v0_right)
```
